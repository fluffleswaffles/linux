## arch/arm/mach-rapuyama/Kconfig
```kconfig
# SPDX-License-Identifier: GPL-2.0-only
config ARCH_RAPUYAMA
	bool "Nokia RapuYama (N8/E6/E7/C7)"
	depends on ARCH_MULTI_V6
	select RAPUYAMA_INTC
	select RAPUYAMA_TIMER
	select GPIOLIB
	select COMMON_CLK
	imply GPIO_RAPUYAMA
	imply I2C
	imply I2C_OMAP
	imply WATCHDOG
	imply RAPUYAMA_WATCHDOG
	imply SERIAL_RAPUYAMA_EARLYCON
	help
	  Support for the Nokia RapuYama application ASIC (ARM1176JZF-S)
	  used in the Symbian^3 phones N8, E6, E7 and C7. The i2c block is
	  the TI OMAP one (omap2420 layout), so it uses i2c-omap.
```

## drivers/soc/rapuyama/Kconfig
```kconfig
# SPDX-License-Identifier: GPL-2.0-only
config SOC_RAPUYAMA_VIDEOCORE
	tristate "Nokia RapuYama BCM2727 VideoCore display"
	depends on ARCH_RAPUYAMA && OF && DRM
	depends on GPIOLIB && COMMON_CLK
	select FW_LOADER
	select DRM_KMS_HELPER
	select DRM_GEM_SHMEM_HELPER
	select BACKLIGHT_CLASS_DEVICE
	help
	  Boots the BCM2727 VideoCore of the Nokia E6 over the ViSSI host bus
	  (firmware vc/vc-loader-a and vc/vc-main, extracted from the Symbian
	  ROM with vc_extract.py), brings the LCD panel up and exposes a
	  640x480 KMS device (and fbdev through the drm emulation) whose
	  plane is pushed to the VideoCore on every change.

	  If unsure, say N.

config RAPUYAMA_E5_DISPLAY
	tristate "Nokia E5-00 RapuYama RFBI panel KMS driver"
	depends on ARCH_RAPUYAMA && DRM && OF
	select DRM_KMS_HELPER
	select DRM_GEM_SHMEM_HELPER
	select BACKLIGHT_CLASS_DEVICE
	help
	  KMS device (/dev/dri/card0, and /dev/fb0 + fbcon through the drm
	  fbdev emulation) for the Nokia E5-00 320x240 command-mode panel
	  behind the OMAP2-style RFBI that Symbian leaves set up. Changed
	  rows are pushed to the panel by DISPC + RFBI DMA when the dt has
	  the DISPC reg and clock, else by the CPU. Screen brightness (panel
	  DCS 0x51) is /sys/class/backlight/panel. Binds the same dt node as
	  FB_RAPUYAMA_E5: enable only one of them.

	  If unsure, say N.

config SOC_RAPUYAMA_MDI
	tristate "Nokia E5/E6 MCU to DSP MDI descriptor transport"
	depends on ARCH_RAPUYAMA && OF
	help
	  Adopts the firmware's existing MCU/DSP descriptor rings and exposes
	  16-byte descriptors through /dev/rapuyama-mdi. The device tree must
	  supply the ring addresses and the RX/TX completion interrupts.
	  This driver does not reset or cold-initialize the modem or its DSP.

	  If unsure, say N.
```
